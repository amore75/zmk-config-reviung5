## boards/shields/numpad5x6/Kconfig.defconfig
```kconfig
# SPDX-License-Identifier: MIT

if SHIELD_NUMPAD5X6

config ZMK_KEYBOARD_NAME
    default "numpad5x6"

endif
```

## config/Kconfig.defconfig
```kconfig
# Default the display on for this shield; honors DT and avoids the long warning.
config ZMK_DISPLAY
    default y if SHIELD_REVIUNG5

config DISPLAY
    default y if SHIELD_REVIUNG5

config SSD1306
    default y if SHIELD_REVIUNG5 && DISPLAY
```

## config/boards/shields/numpad5x6/Kconfig.defconfig
```kconfig
# Copyright (c) 2022 The ZMK Contributors
# SPDX-License-Identifier: MIT

if SHIELD_NUMPAD5X6

config ZMK_KEYBOARD_NAME
    default "Numpad 5x6"

endif
```

## config/boards/shields/numpad5x6/Kconfig.shield
```kconfig
# SPDX-License-Identifier: MIT

config SHIELD_NUMPAD5X6
    def_bool $(shields_list_contains,numpad5x6)
    select ZMK_KEYBOARD_SHIELD
```

## west.yml
```yaml
manifest:
  remotes:
    - name: zmkfirmware
      url-base: https://github.com/zmkfirmware
  projects:
    - name: zmk
      remote: zmkfirmware
      revision: v0.2        # use "main" if you chose @main above
      import: app/west.yml
  self:
    path: config
```
